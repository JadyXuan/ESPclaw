## glove/sdkconfig.defaults
```kconfig
CONFIG_IDF_TARGET="esp32c3"

# Arduino support
CONFIG_AUTOSTART_ARDUINO=y
CONFIG_FREERTOS_HZ=1000

# USB CDC for serial output
CONFIG_ESP_CONSOLE_USB_SERIAL_JTAG=y

# Partition table
CONFIG_PARTITION_TABLE_SINGLE_APP_LARGE=y
```
